## saha-layers/meta-tegra-saha/conf/distro/tegra-saha.conf
```bitbake
DISTRO = "tegra-saha"
DISTRO_NAME = "Saha project distro for tegra"
# Based on tegrademo 3.5
DISTRO_VERSION_BASE = "alpha-1.0"
DISTRO_VERSION = "${DISTRO_VERSION_BASE}-${DATE}"
DISTRO_CODENAME = "wrynose"
SDK_VENDOR = "-tdsdk"
SDK_VERSION := "${DISTRO_VERSION}"

MAINTAINER = "Homalozoa <nx.tardis@gmail.com>"

TARGET_VENDOR = "-cyberzoo"

# New ${DISTRO}-<version> setting for sanity checks.
# Increment version number (and the corresponding
# setting int the template bblayers.conf.sample file)
# each time the layer settings are changed.
REQUIRED_TD_BBLAYERS_CONF_VERSION = "${DISTRO}-1"

LOCALCONF_VERSION = "1"

DISTRO_VERSION[vardepsexclude] = "DATE"
SDK_VERSION[vardepsexclude] = "DATE"

TD_DEFAULT_DISTRO_FEATURES = "largefile opengl vulkan multiarch systemd pam virtualization"
BL_DISTRO_FEATURES = "vfat"

DISTRO_FEATURES ?= "${DISTRO_FEATURES_DEFAULTS} ${TD_DEFAULT_DISTRO_FEATURES} ${BL_DISTRO_FEATURES}"

SDK_NAME = "${DISTRO}-${TCLIBC}-${SDKMACHINE}-${IMAGE_BASENAME}-${TUNE_PKGARCH}-${MACHINE}"
SDKPATH = "/opt/${DISTRO}/${SDK_VERSION}"

PREMIRRORS ??= "\
bzr://.*/.*   http://downloads.yoctoproject.org/mirror/sources/ \n \
cvs://.*/.*   http://downloads.yoctoproject.org/mirror/sources/ \n \
git://.*/.*   http://downloads.yoctoproject.org/mirror/sources/ \n \
gitsm://.*/.* http://downloads.yoctoproject.org/mirror/sources/ \n \
hg://.*/.*    http://downloads.yoctoproject.org/mirror/sources/ \n \
osc://.*/.*   http://downloads.yoctoproject.org/mirror/sources/ \n \
p4://.*/.*    http://downloads.yoctoproject.org/mirror/sources/ \n \
svn://.*/.*   http://downloads.yoctoproject.org/mirror/sources/ \n"

SANITY_TESTED_DISTROS ?= " \
            ubuntu-18.04 \n \
            ubuntu-20.04 \n \
            ubuntu-20.10 \n \
            ubuntu-21.04 \n \
            ubuntu-22.04 \n \
            arch \n \
            "

# Most NVIDIA-supplied services expect systemd
INIT_MANAGER = "systemd"

RMW_IMPLEMENTATION = "rmw_fastrtps_cpp"

INHERIT += "tegra-support-sanity"

INHERIT += "uninative"

BB_SIGNATURE_HANDLER ?= "OEEquivHash"
BB_HASHSERVE ??= "auto"

LICENSE_FLAGS_ACCEPTED += "commercial_faad2"

PREFERRED_PROVIDER_virtual/bootlogo_tegra = "bootlogo-custom"

# # Mender additions
# INHERIT += "mender-full distro_layer_buildinfo"
# INHERIT:append:tegra = " tegra-mender-setup mender-workarounds"

# BUILDNAME ?= "${DISTRO_VERSION}-${DISTRO_LAYER_BUILDTAG}"
# BUILDNAME[vardepvalue] = "${DISTRO_VERSION}"

# MENDER_ARTIFACT_NAME ?= "${IMAGE_BASENAME}_${BUILDNAME}"

# IMAGE_FSTYPES:tegra = "tegraflash mender dataimg"
# IMAGE_FSTYPES:pn-tegra-minimal-initramfs:tegra = "${INITRAMFS_FSTYPES}"
# IMAGE_FEATURES:append = " read-only-rootfs"
# IMGCLASSES:append = " rootfs-postcommands-overrides"

# # Reserved space for tegraflash partitions, not including APP and DATA
# TEGRA_FLASH_PARTITIONS_MB ?= "950"

# # Make more room for the data partition, so we can use it to hold
# # docker container filesystems.
# MENDER_DATA_PART_SIZE_MB_DEFAULT:tegra = "3072"

# MENDER_STORAGE_DEVICE_BASE ?= "/dev/mmcblk0p"
# MENDER_STORAGE_TOTAL_SIZE_MB ?= "${@tegra_mender_calc_total_size(d) - int(d.getVar('TEGRA_FLASH_PARTITIONS_MB'))}"
```

## saha-layers/meta-tegra-saha/conf/layer.conf
```bitbake
BBPATH =. "${LAYERDIR}:"

# Do not use recipes-* here: recipes-ros is loaded only via BBFILES_DYNAMIC.
BBFILES += "${LAYERDIR}/recipes-bsp/*/*.bb ${LAYERDIR}/recipes-bsp/*/*.bbappend"
BBFILES += "${LAYERDIR}/recipes-connectivity/*/*.bb ${LAYERDIR}/recipes-connectivity/*/*.bbappend"
BBFILES += "${LAYERDIR}/recipes-core/*/*.bb ${LAYERDIR}/recipes-core/*/*.bbappend"
BBFILES += "${LAYERDIR}/recipes-saha/*/*.bb ${LAYERDIR}/recipes-saha/*/*.bbappend"
BBFILES += "${LAYERDIR}/recipes-support/*/*.bb ${LAYERDIR}/recipes-support/*/*.bbappend"

# ROS bbappends and packagegroups require meta-ros2 (ros2-layer).
BBFILES_DYNAMIC += " \
  ros2-layer:${LAYERDIR}/recipes-ros/*/*.bb \
  ros2-layer:${LAYERDIR}/recipes-ros/*/*.bbappend \
"

BBFILE_COLLECTIONS += "tegra-saha"
BBFILE_PATTERN_tegra-saha = "^${LAYERDIR}/"
BBFILE_PRIORITY_tegra-saha = "50"

LAYERVERSION_tegra-saha = "4"
LAYERSERIES_COMPAT_tegra-saha = "wrynose"

# This is used by the tegra-distro-sanity bbclass
# to identify the distro layer directory during
# bblayers checks.
TD_DISTRO_LAYERDIR = "${LAYERDIR}"
```
